// SPDX-License-Identifier: AGPL-3.0-or-later
// SPDX-FileCopyrightText: 2026 lahiru
// oled.c - see oled.h.

#include "oled.h"

#include <string.h>

/* Classic 5x7 font, ASCII 0x20..0x7E, 5 column bytes per glyph, bit 0 = top. */
static const uint8_t k_font[95][5] = {
    {0x00, 0x00, 0x00, 0x00, 0x00}, /* ' ' */
    {0x00, 0x00, 0x5F, 0x00, 0x00}, /* ! */
    {0x00, 0x07, 0x00, 0x07, 0x00}, /* " */
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    {0x02, 0x01, 0x02, 0x04, 0x02}, /* ~ */
};

/* 128x64, internal charge pump, segment remap + COM scan reversed (the
 * usual module orientation, pins at the top). */
static const uint8_t k_init[] = {
    OLED_CTRL_CMD,
    0xAE,       /* display off */
    0xD5, 0x80, /* clock divide / oscillator */
    0xA8, 0x3F, /* multiplex 64 */
    0xD3, 0x00, /* display offset 0 */
    0x40,       /* start line 0 */
    0x8D, 0x14, /* charge pump on (SSD1306; SH1106 ignores it) */
    0xA1,       /* segment remap */
    0xC8,       /* COM scan descending */
    0xDA, 0x12, /* COM pins: alternative, 64 rows */
    0x81, 0xCF, /* contrast */
    0xD9, 0xF1, /* pre-charge */
    0xDB, 0x40, /* VCOMH deselect */
    0x2E,       /* scroll off */
    0xA4,       /* display follows RAM */
    0xA6,       /* normal (not inverted) */
    0xAF,       /* display on */
};

const uint8_t *oled_glyph(char c)
{
    const unsigned u = (unsigned char)c;
    if (u < 0x20u || u > 0x7Eu) {
        return k_font[0];
    }
    return k_font[u - 0x20u];
}

void oled_setup(oled_t *o, oled_write_fn write, void *user, uint8_t col_offset)
{
    memset(o, 0, sizeof *o);
    o->write = write;
    o->user = user;
    o->col_offset = col_offset;
}

bool oled_init(oled_t *o)
{
    return o->write != NULL && o->write(o->user, k_init, sizeof k_init);
}

bool oled_invert(oled_t *o, bool on)
{
    const uint8_t cmd[2] = {OLED_CTRL_CMD, on ? 0xA7u : 0xA6u};
    return o->write != NULL && o->write(o->user, cmd, sizeof cmd);
}

void oled_clear(oled_t *o)
{
    memset(o->fb, 0, sizeof o->fb);
}

void oled_pixel(oled_t *o, unsigned x, unsigned y, bool on)
{
    if (x >= OLED_W || y >= OLED_H) {
        return;
    }
    const uint8_t bit = (uint8_t)(1u << (y & 7u));
    if (on) {
        o->fb[y / 8u][x] |= bit;
    } else {
        o->fb[y / 8u][x] &= (uint8_t)~bit;
    }
}

void oled_text(oled_t *o, unsigned row, unsigned col, const char *s)
{
    if (row >= OLED_ROWS || s == NULL) {
        return;
    }
    for (unsigned x = col * 6u; *s != '\0' && x + 6u <= OLED_W; s++, x += 6u) {
        const uint8_t *g = oled_glyph(*s);
        memcpy(&o->fb[row][x], g, 5u);
        o->fb[row][x + 5u] = 0u;
    }
}

void oled_text_x2(oled_t *o, unsigned row, unsigned col, const char *s)
{
    if (row + 1u >= OLED_ROWS || s == NULL) {
        return;
    }
    const unsigned y0 = row * 8u;
    for (unsigned x = col * 12u; *s != '\0' && x + 12u <= OLED_W; s++, x += 12u) {
        const uint8_t *g = oled_glyph(*s);
        for (unsigned cx = 0; cx < 6u; cx++) {
            const uint8_t bits = cx < 5u ? g[cx] : 0u;
            for (unsigned cy = 0; cy < 8u; cy++) {
                const bool on = ((bits >> cy) & 1u) != 0u;
                oled_pixel(o, x + 2u * cx, y0 + 2u * cy, on);
                oled_pixel(o, x + 2u * cx + 1u, y0 + 2u * cy, on);
                oled_pixel(o, x + 2u * cx, y0 + 2u * cy + 1u, on);
                oled_pixel(o, x + 2u * cx + 1u, y0 + 2u * cy + 1u, on);
            }
        }
    }
}

bool oled_flush(oled_t *o)
{
    if (o->write == NULL) {
        return false;
    }
    uint8_t buf[1u + OLED_W];
    for (unsigned p = 0; p < OLED_PAGES; p++) {
        const unsigned col = o->col_offset;
        const uint8_t cmd[4] = {OLED_CTRL_CMD, (uint8_t)(0xB0u + p), (uint8_t)(col & 0x0Fu),
                                (uint8_t)(0x10u | (col >> 4))};
        if (!o->write(o->user, cmd, sizeof cmd)) {
            return false;
        }
        buf[0] = OLED_CTRL_DATA;
        memcpy(&buf[1], o->fb[p], OLED_W);
        if (!o->write(o->user, buf, sizeof buf)) {
            return false;
        }
    }
    return true;
}
