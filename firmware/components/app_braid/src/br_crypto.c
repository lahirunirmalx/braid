// SPDX-License-Identifier: AGPL-3.0-or-later
// SPDX-FileCopyrightText: 2026 lahiru
/*
 * br_crypto.c - HKDF / HMAC-SHA256 / AES-128-CCM / hop_tag over mbedtls (spec 8.2, 8.3)
 * and the field-profile test-key blacklist (12.1).
 *
 * Heap: only br_crypto_init() allocates (mbedtls_md_setup). HMAC and HKDF
 * reuse c->hmac. AES-CCM is implemented here (RFC 3610 / SP 800-38C, M = 8,
 * L = 2, 13-byte nonce) on a stack mbedtls_aes_context; the reason and the
 * validation evidence are in br_crypto.h.
 *
 * Every secret-dependent scratch buffer is wiped with mbedtls_platform_zeroize
 * on every exit path. Tag checks use br_ct_equal().
 *
 * Error precedence (br_crypto.h, N20): NULL pointers -> BR_ERR_ARG, then an
 * uninitialised context -> BR_ERR_STATE, then length / range limits -> BR_ERR_ARG.
 */
#include <string.h>

#include "braid/br_crypto.h"
#include "braid/br_frame.h"

#include "mbedtls/aes.h"
#include "mbedtls/platform_util.h"
#include "mbedtls/sha256.h"

#include "br_internal.h"

#define CCM_BLOCK 16u
#define CCM_L     2u

/* ------------------------------------------------------------------------- */
/* Context                                                                    */
/* ------------------------------------------------------------------------- */

br_err_t br_crypto_init(br_crypto_t *c)
{
    if (c == NULL) {
        return BR_ERR_ARG;
    }
    memset(c, 0, sizeof *c);
    mbedtls_md_init(&c->hmac);

    const mbedtls_md_info_t *info = mbedtls_md_info_from_type(MBEDTLS_MD_SHA256);
    if (info == NULL) {
        mbedtls_md_free(&c->hmac);
        mbedtls_platform_zeroize(c, sizeof *c);
        return BR_ERR_CRYPTO;
    }
    int ret = mbedtls_md_setup(&c->hmac, info, 1);
    if (ret != 0) {
        mbedtls_md_free(&c->hmac);
        mbedtls_platform_zeroize(c, sizeof *c);
        return (ret == MBEDTLS_ERR_MD_ALLOC_FAILED) ? BR_ERR_NO_MEM : BR_ERR_CRYPTO;
    }
    c->ready = true;
    return BR_OK;
}

void br_crypto_free(br_crypto_t *c)
{
    if (c == NULL) {
        return;
    }
    if (c->ready) {
        mbedtls_md_free(&c->hmac);
    }
    mbedtls_platform_zeroize(c, sizeof *c);
}

/* ------------------------------------------------------------------------- */
/* HMAC-SHA256 and HKDF (RFC 2104, RFC 5869)                                  */
/* ------------------------------------------------------------------------- */

/* HMAC over up to three concatenated parts; NULL part allowed iff its len is 0. */
static br_err_t hmac3(br_crypto_t *c, const uint8_t *key, size_t key_len,
                      const uint8_t *p1, size_t n1, const uint8_t *p2, size_t n2,
                      const uint8_t *p3, size_t n3, uint8_t mac_out[BR_SHA256_LEN])
{
    static const uint8_t empty = 0u; /* mbedtls never gets a NULL pointer */
    int ret = mbedtls_md_hmac_starts(&c->hmac, (key_len > 0u) ? key : &empty, key_len);
    if (ret == 0 && n1 > 0u) {
        ret = mbedtls_md_hmac_update(&c->hmac, p1, n1);
    }
    if (ret == 0 && n2 > 0u) {
        ret = mbedtls_md_hmac_update(&c->hmac, p2, n2);
    }
    if (ret == 0 && n3 > 0u) {
        ret = mbedtls_md_hmac_update(&c->hmac, p3, n3);
    }
    if (ret == 0) {
        ret = mbedtls_md_hmac_finish(&c->hmac, mac_out);
    }
    if (ret != 0) {
        mbedtls_platform_zeroize(mac_out, BR_SHA256_LEN);
        return BR_ERR_CRYPTO;
    }
    return BR_OK;
}

br_err_t br_hmac_sha256(br_crypto_t *c, const uint8_t *key, size_t key_len,
                        const uint8_t *data, size_t len, uint8_t mac_out[BR_SHA256_LEN])
{
    if (c == NULL || mac_out == NULL || (key == NULL && key_len > 0u) ||
        (data == NULL && len > 0u)) {
        return BR_ERR_ARG;
    }
    if (!c->ready) {
        return BR_ERR_STATE;
    }
    return hmac3(c, key, key_len, data, len, NULL, 0u, NULL, 0u, mac_out);
}

br_err_t br_hkdf_extract(br_crypto_t *c, const uint8_t *salt, size_t salt_len,
                         const uint8_t *ikm, size_t ikm_len, uint8_t prk_out[BR_SHA256_LEN])
{
    static const uint8_t zero_salt[BR_SHA256_LEN] = {0};
    if (c == NULL || prk_out == NULL || (salt == NULL && salt_len > 0u) ||
        (ikm == NULL && ikm_len > 0u)) {
        return BR_ERR_ARG;
    }
    if (!c->ready) {
        return BR_ERR_STATE;
    }
    if (salt_len == 0u) {
        /* RFC 5869 2.2: absent salt = HashLen zero bytes (same HMAC key as an empty one). */
        salt = zero_salt;
        salt_len = sizeof zero_salt;
    }
    return hmac3(c, salt, salt_len, ikm, ikm_len, NULL, 0u, NULL, 0u, prk_out);
}

br_err_t br_hkdf_expand(br_crypto_t *c, const uint8_t *prk, size_t prk_len,
                        const uint8_t *info, size_t info_len, uint8_t *okm_out, size_t okm_len)
{
    if (c == NULL || prk == NULL || okm_out == NULL || (info == NULL && info_len > 0u)) {
        return BR_ERR_ARG;
    }
    if (!c->ready) {
        return BR_ERR_STATE;
    }
    if (prk_len < BR_SHA256_LEN || okm_len == 0u || okm_len > BR_HKDF_MAX_OKM) {
        return BR_ERR_ARG;
    }
    uint8_t t[BR_SHA256_LEN];
    size_t t_len = 0u;
    size_t done = 0u;
    uint8_t ctr = 0u;
    br_err_t rc = BR_OK;
    while (done < okm_len) {
        ctr++;
        rc = hmac3(c, prk, prk_len, t, t_len, info, info_len, &ctr, 1u, t);
        if (rc != BR_OK) {
            mbedtls_platform_zeroize(okm_out, okm_len);
            break;
        }
        t_len = BR_SHA256_LEN;
        size_t n = okm_len - done;
        if (n > BR_SHA256_LEN) {
            n = BR_SHA256_LEN;
        }
        memcpy(&okm_out[done], t, n);
        done += n;
    }
    mbedtls_platform_zeroize(t, sizeof t);
    return rc;
}

br_err_t br_hkdf_sha256(br_crypto_t *c, const uint8_t *salt, size_t salt_len,
                        const uint8_t *ikm, size_t ikm_len,
                        const uint8_t *info, size_t info_len, uint8_t *okm_out, size_t okm_len)
{
    if (c == NULL || okm_out == NULL || (salt == NULL && salt_len > 0u) ||
        (ikm == NULL && ikm_len > 0u) || (info == NULL && info_len > 0u)) {
        return BR_ERR_ARG;
    }
    if (!c->ready) {
        return BR_ERR_STATE;
    }
    if (okm_len == 0u || okm_len > BR_HKDF_MAX_OKM) {
        return BR_ERR_ARG;
    }
    uint8_t prk[BR_SHA256_LEN];
    br_err_t rc = br_hkdf_extract(c, salt, salt_len, ikm, ikm_len, prk);
    if (rc == BR_OK) {
        rc = br_hkdf_expand(c, prk, sizeof prk, info, info_len, okm_out, okm_len);
    }
    mbedtls_platform_zeroize(prk, sizeof prk);
    return rc;
}

/* ------------------------------------------------------------------------- */
/* Nonce and AAD (8.3)                                                        */
/* ------------------------------------------------------------------------- */

br_err_t br_ccm_nonce(uint8_t dir, uint16_t src_id, uint16_t dst_id, uint8_t session_id,
                      uint32_t ctr_hi, uint16_t seq, uint8_t nonce_out[BR_CCM_NONCE_LEN])
{
    if (nonce_out == NULL || dir > BR_DIR_BUNDLE) {
        return BR_ERR_ARG;
    }
    if (dir == BR_DIR_BUNDLE) {
        /* 8.6: 0x02 || N u16 || bundle_no u32 || 0x00 x 6 */
        if (dst_id != 0u || session_id != 0u || seq != 0u) {
            return BR_ERR_ARG;
        }
        memset(nonce_out, 0, BR_CCM_NONCE_LEN);
        nonce_out[0] = dir;
        br_wr_le16(&nonce_out[1], src_id);
        br_wr_le32(&nonce_out[3], ctr_hi);
        return BR_OK;
    }
    nonce_out[0] = dir;
    br_wr_le16(&nonce_out[1], src_id);
    br_wr_le16(&nonce_out[3], dst_id);
    nonce_out[5] = session_id;
    br_wr_le32(&nonce_out[6], ctr_hi);
    br_wr_le16(&nonce_out[10], seq);
    nonce_out[12] = 0u;
    return BR_OK;
}

br_err_t br_ccm_aad(const uint8_t *frame, size_t frame_len, uint32_t ctr_hi, size_t clear_len,
                    uint8_t *aad_out, size_t cap, size_t *aad_len)
{
    if (frame == NULL || aad_out == NULL || aad_len == NULL) {
        return BR_ERR_ARG;
    }
    if (frame_len < 2u) {
        return BR_ERR_DECODE;
    }
    const size_t hl = br_hdr_len_for_type(frame[BR_OFF_TYPE]);
    if (frame_len < hl) {
        return BR_ERR_DECODE;
    }
    const bool seek = (hl == BR_HDR_LEN_SEEK);
    const size_t off_sid = seek ? BR_OFF_SESSION_ID_SEEK : BR_OFF_SESSION_ID;
    const size_t off_seq = seek ? BR_OFF_SEQ_SEEK : BR_OFF_SEQ;
    const size_t off_len = seek ? BR_OFF_LEN_SEEK : BR_OFF_LEN;
    if (clear_len > frame[off_len]) {
        return BR_ERR_ARG;
    }
    if (frame_len - hl < clear_len) {
        return BR_ERR_DECODE;
    }
    const size_t total = BR_E2E_HDR_LEN + 4u + clear_len;
    if (cap < total) {
        return BR_ERR_TOO_BIG;
    }
    memcpy(&aad_out[0], &frame[0], 6u);
    aad_out[6] = frame[off_sid];
    memcpy(&aad_out[7], &frame[off_seq], 2u);
    aad_out[9] = frame[off_len];
    br_wr_le32(&aad_out[10], ctr_hi);
    if (clear_len > 0u) {
        memcpy(&aad_out[14], &frame[hl], clear_len);
    }
    *aad_len = total;
    return BR_OK;
}

/* ------------------------------------------------------------------------- */
/* AES-128-CCM, M = 8, L = 2 (RFC 3610)                                       */
/* ------------------------------------------------------------------------- */

typedef struct {
    mbedtls_aes_context aes;
    uint8_t x[CCM_BLOCK];    /* CBC-MAC state */
    uint8_t ctr[CCM_BLOCK];  /* counter block A_i */
    uint8_t s[CCM_BLOCK];    /* key stream block S_i */
    uint8_t tmp[CCM_BLOCK];
    size_t  pos;             /* bytes absorbed into the current MAC block */
} ccm_state_t;

static int ccm_enc_block(ccm_state_t *st, const uint8_t in[CCM_BLOCK], uint8_t out[CCM_BLOCK])
{
    int ret = mbedtls_aes_crypt_ecb(&st->aes, MBEDTLS_AES_ENCRYPT, in, st->tmp);
    memcpy(out, st->tmp, CCM_BLOCK);
    return ret;
}

static int ccm_mac_bytes(ccm_state_t *st, const uint8_t *p, size_t n)
{
    for (size_t i = 0u; i < n; i++) {
        st->x[st->pos] = (uint8_t)(st->x[st->pos] ^ p[i]);
        st->pos++;
        if (st->pos == CCM_BLOCK) {
            int ret = ccm_enc_block(st, st->x, st->x);
            if (ret != 0) {
                return ret;
            }
            st->pos = 0u;
        }
    }
    return 0;
}

static int ccm_mac_pad(ccm_state_t *st)
{
    if (st->pos == 0u) {
        return 0;
    }
    st->pos = 0u;
    return ccm_enc_block(st, st->x, st->x);
}

/* Set the key and absorb B0 and the AAD; leaves the counter at A_0. */
static int ccm_start(ccm_state_t *st, const uint8_t key[BR_AES_KEY_LEN],
                     const uint8_t nonce[BR_CCM_NONCE_LEN],
                     const uint8_t *aad, size_t aad_len, size_t msg_len)
{
    memset(st, 0, sizeof *st);
    mbedtls_aes_init(&st->aes);
    int ret = mbedtls_aes_setkey_enc(&st->aes, key, 128u);
    if (ret != 0) {
        return ret;
    }
    /* B0: flags = Adata << 6 | ((M - 2) / 2) << 3 | (L - 1); nonce; l(m) BE16. */
    uint8_t b0[CCM_BLOCK];
    b0[0] = (uint8_t)(((aad_len > 0u) ? 0x40u : 0u) |
                      (((BR_CCM_TAG_LEN - 2u) / 2u) << 3) | (CCM_L - 1u));
    memcpy(&b0[1], nonce, BR_CCM_NONCE_LEN);
    b0[14] = (uint8_t)(msg_len >> 8);
    b0[15] = (uint8_t)(msg_len & 0xFFu);
    ret = ccm_enc_block(st, b0, st->x);
    mbedtls_platform_zeroize(b0, sizeof b0);
    if (ret != 0) {
        return ret;
    }
    if (aad_len > 0u) {
        /* 0 < l(a) < 2^16 - 2^8: two-byte big-endian length prefix. */
        const uint8_t alen[2] = { (uint8_t)(aad_len >> 8), (uint8_t)(aad_len & 0xFFu) };
        ret = ccm_mac_bytes(st, alen, sizeof alen);
        if (ret == 0) {
            ret = ccm_mac_bytes(st, aad, aad_len);
        }
        if (ret == 0) {
            ret = ccm_mac_pad(st);
        }
        if (ret != 0) {
            return ret;
        }
    }
    /* A_i = (L - 1) || nonce || i BE16 */
    st->ctr[0] = (uint8_t)(CCM_L - 1u);
    memcpy(&st->ctr[1], nonce, BR_CCM_NONCE_LEN);
    return 0;
}

static int ccm_keystream(ccm_state_t *st, uint16_t i)
{
    st->ctr[14] = (uint8_t)(i >> 8);
    st->ctr[15] = (uint8_t)(i & 0xFFu);
    return ccm_enc_block(st, st->ctr, st->s);
}

/* tag = first 8 bytes of (CBC-MAC XOR S_0). */
static int ccm_finish_tag(ccm_state_t *st, uint8_t tag[BR_CCM_TAG_LEN])
{
    int ret = ccm_mac_pad(st);
    if (ret == 0) {
        ret = ccm_keystream(st, 0u);
    }
    if (ret == 0) {
        for (size_t i = 0u; i < BR_CCM_TAG_LEN; i++) {
            tag[i] = (uint8_t)(st->x[i] ^ st->s[i]);
        }
    }
    return ret;
}

static void ccm_wipe(ccm_state_t *st)
{
    mbedtls_aes_free(&st->aes);
    mbedtls_platform_zeroize(st, sizeof *st);
}

/* NULL-pointer rules (checked before the context state). */
static bool ccm_ptrs_ok(const uint8_t *key, const uint8_t *nonce, const uint8_t *aad,
                        size_t aad_len, const uint8_t *in, size_t len, const uint8_t *out,
                        const uint8_t *tag)
{
    return key != NULL && nonce != NULL && tag != NULL &&
           !(aad == NULL && aad_len > 0u) && !(len > 0u && (in == NULL || out == NULL));
}

/* Range rules (checked after the context state). */
static bool ccm_lens_ok(size_t aad_len, size_t len)
{
    return aad_len <= BR_AAD_MAX_LEN && len <= 255u;
}

br_err_t br_ccm_encrypt(br_crypto_t *c, const uint8_t key[BR_AES_KEY_LEN],
                        const uint8_t nonce[BR_CCM_NONCE_LEN],
                        const uint8_t *aad, size_t aad_len,
                        const uint8_t *pt, size_t pt_len,
                        uint8_t *ct_out, uint8_t tag_out[BR_CCM_TAG_LEN])
{
    if (c == NULL || !ccm_ptrs_ok(key, nonce, aad, aad_len, pt, pt_len, ct_out, tag_out)) {
        return BR_ERR_ARG;
    }
    if (!c->ready) {
        return BR_ERR_STATE;
    }
    if (!ccm_lens_ok(aad_len, pt_len)) {
        return BR_ERR_ARG;
    }
    ccm_state_t st;
    int ret = ccm_start(&st, key, nonce, aad, aad_len, pt_len);
    uint16_t blk = 1u;
    for (size_t off = 0u; ret == 0 && off < pt_len; off += CCM_BLOCK, blk++) {
        size_t n = pt_len - off;
        if (n > CCM_BLOCK) {
            n = CCM_BLOCK;
        }
        /* MAC the plaintext chunk before it may be overwritten (in place). */
        ret = ccm_mac_bytes(&st, &pt[off], n);
        if (ret == 0) {
            ret = ccm_keystream(&st, blk);
        }
        if (ret == 0) {
            for (size_t j = 0u; j < n; j++) {
                ct_out[off + j] = (uint8_t)(pt[off + j] ^ st.s[j]);
            }
        }
    }
    if (ret == 0) {
        ret = ccm_finish_tag(&st, tag_out);
    }
    ccm_wipe(&st);
    if (ret != 0) {
        if (pt_len > 0u && ct_out != pt) {
            mbedtls_platform_zeroize(ct_out, pt_len);
        }
        mbedtls_platform_zeroize(tag_out, BR_CCM_TAG_LEN);
        return BR_ERR_CRYPTO;
    }
    return BR_OK;
}

br_err_t br_ccm_decrypt(br_crypto_t *c, const uint8_t key[BR_AES_KEY_LEN],
                        const uint8_t nonce[BR_CCM_NONCE_LEN],
                        const uint8_t *aad, size_t aad_len,
                        const uint8_t *ct, size_t ct_len,
                        const uint8_t tag[BR_CCM_TAG_LEN], uint8_t *pt_out)
{
    if (c == NULL || !ccm_ptrs_ok(key, nonce, aad, aad_len, ct, ct_len, pt_out, tag)) {
        return BR_ERR_ARG;
    }
    if (!c->ready) {
        return BR_ERR_STATE;
    }
    if (!ccm_lens_ok(aad_len, ct_len)) {
        return BR_ERR_ARG;
    }
    ccm_state_t st;
    uint8_t calc[BR_CCM_TAG_LEN];
    int ret = ccm_start(&st, key, nonce, aad, aad_len, ct_len);
    uint16_t blk = 1u;
    for (size_t off = 0u; ret == 0 && off < ct_len; off += CCM_BLOCK, blk++) {
        size_t n = ct_len - off;
        if (n > CCM_BLOCK) {
            n = CCM_BLOCK;
        }
        ret = ccm_keystream(&st, blk);
        if (ret == 0) {
            for (size_t j = 0u; j < n; j++) {
                pt_out[off + j] = (uint8_t)(ct[off + j] ^ st.s[j]);
            }
            ret = ccm_mac_bytes(&st, &pt_out[off], n);
        }
    }
    if (ret == 0) {
        ret = ccm_finish_tag(&st, calc);
    }
    ccm_wipe(&st);
    br_err_t rc;
    if (ret != 0) {
        rc = BR_ERR_CRYPTO;
    } else {
        rc = (br_ct_equal(calc, tag, BR_CCM_TAG_LEN) == BR_OK) ? BR_OK : BR_ERR_AUTH;
    }
    mbedtls_platform_zeroize(calc, sizeof calc);
    if (rc != BR_OK && ct_len > 0u) {
        mbedtls_platform_zeroize(pt_out, ct_len); /* never release unauthenticated plaintext */
    }
    return rc;
}

/* ------------------------------------------------------------------------- */
/* hop_tag (8.3)                                                              */
/* ------------------------------------------------------------------------- */

br_err_t br_hop_tag(br_crypto_t *c, const uint8_t k_hop[BR_HOP_KEY_LEN],
                    const uint8_t *frame, size_t covered_len, uint8_t tag_out[BR_HOP_TAG_LEN])
{
    if (c == NULL || k_hop == NULL || frame == NULL || tag_out == NULL) {
        return BR_ERR_ARG;
    }
    if (!c->ready) {
        return BR_ERR_STATE;
    }
    /* 27 first (frame[1] is then readable), then the type-dependent 30 for SEEK (N18). */
    if (covered_len < (size_t)BR_HDR_LEN + BR_AUTH_TAG_LEN ||
        covered_len < br_hdr_len_for_type(frame[BR_OFF_TYPE]) + BR_AUTH_TAG_LEN) {
        return BR_ERR_ARG;
    }
    uint8_t mac[BR_SHA256_LEN];
    br_err_t rc = hmac3(c, k_hop, BR_HOP_KEY_LEN, frame, covered_len, NULL, 0u, NULL, 0u, mac);
    if (rc == BR_OK) {
        memcpy(tag_out, mac, BR_HOP_TAG_LEN);
    }
    mbedtls_platform_zeroize(mac, sizeof mac);
    return rc;
}

br_err_t br_hop_tag_verify(br_crypto_t *c, const uint8_t k_hop[BR_HOP_KEY_LEN],
                           const uint8_t *frame, size_t covered_len,
                           const uint8_t tag[BR_HOP_TAG_LEN])
{
    if (tag == NULL) {
        return BR_ERR_ARG;
    }
    uint8_t calc[BR_HOP_TAG_LEN];
    br_err_t rc = br_hop_tag(c, k_hop, frame, covered_len, calc);
    if (rc == BR_OK) {
        rc = (br_ct_equal(calc, tag, BR_HOP_TAG_LEN) == BR_OK) ? BR_OK : BR_ERR_AUTH;
    }
    mbedtls_platform_zeroize(calc, sizeof calc);
    return rc;
}

/* ------------------------------------------------------------------------- */
/* Utilities                                                                  */
/* ------------------------------------------------------------------------- */

br_err_t br_ct_equal(const uint8_t *a, const uint8_t *b, size_t len)
{
    if (len > 0u && (a == NULL || b == NULL)) {
        return BR_ERR_ARG;
    }
    const volatile uint8_t *va = a;
    const volatile uint8_t *vb = b;
    volatile uint8_t diff = 0u;
    for (size_t i = 0u; i < len; i++) {
        diff = (uint8_t)(diff | (uint8_t)(va[i] ^ vb[i]));
    }
    return (diff == 0u) ? BR_OK : BR_ERR_AUTH;
}

void br_secure_zero(void *p, size_t len)
{
    if (p == NULL || len == 0u) {
        return;
    }
    mbedtls_platform_zeroize(p, len);
}

/* ------------------------------------------------------------------------- */
/* Field-profile test-key blacklist (12.1)                                    */
/* ------------------------------------------------------------------------- */

/*
 * SHA-256(K_mesh(E))[0..7] for E = 0..255, K_mesh(E) = HKDF(IKM = K_site,
 * salt "Braid-mesh", info E u8, L 32) with the Appendix A TEST ONLY
 * K_site = 00 01 .. 1f. Generated in place by
 * `python3 tools/vectors.py --emit-kmesh-hash8 <this file>` (same K_mesh as
 * A.6 K_mesh(1) and A.14 K_mesh(2)). Hash prefixes only, so
 * the firmware image does not carry the test keys themselves.
 */
static const uint8_t s_test_kmesh_hash8[256][8] = {
    {0x60, 0x23, 0x60, 0xa4, 0xc4, 0xa5, 0x84, 0x00}, /* E 0 */
    {0x4d, 0xd0, 0x43, 0x95, 0x56, 0x1a, 0xe0, 0x6f}, /* E 1 */
    {0x37, 0x09, 0x8a, 0x91, 0xf3, 0xe6, 0x42, 0x0a}, /* E 2 */
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    {0xaf, 0xc6, 0x64, 0xde, 0x7e, 0xc4, 0xbe, 0xff}, /* E 255 */
};

br_err_t br_key_check_field(const uint8_t *key, size_t key_len)
{
    if (key == NULL || key_len == 0u) {
        return BR_ERR_ARG;
    }
    /* All-equal (all-zero included): accumulate without early exit. */
    uint8_t spread = 0u;
    for (size_t i = 1u; i < key_len; i++) {
        spread = (uint8_t)(spread | (uint8_t)(key[i] ^ key[0]));
    }
    uint32_t hit = (uint32_t)(((uint32_t)spread - 1u) >> 8) & 1u; /* 1 iff spread == 0 */

    if (key_len == BR_SHA256_LEN) {
        uint8_t h[BR_SHA256_LEN];
        if (mbedtls_sha256(key, key_len, h, 0) != 0) {
            mbedtls_platform_zeroize(h, sizeof h);
            return BR_ERR_CRYPTO;
        }
        for (size_t e = 0u; e < 256u; e++) {
            uint32_t d = 0u;
            for (size_t j = 0u; j < 8u; j++) {
                d |= (uint32_t)(h[j] ^ s_test_kmesh_hash8[e][j]);
            }
            hit |= ((d - 1u) >> 8) & 1u; /* d in 0..255: 1 iff d == 0 */
        }
        mbedtls_platform_zeroize(h, sizeof h);
    }
    return (hit != 0u) ? BR_ERR_AUTH : BR_OK;
}
